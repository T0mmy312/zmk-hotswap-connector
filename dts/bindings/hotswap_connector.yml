## dts/bindings/hotswap_connector.yml
```yaml
description: |
  a spi hotswap connector device that detects the current sensor

compatible: hotswap-connector

properties:
  irq-gpios:
    type: phandle-array
    required: true
  potential-devices:
    type: phandles
    required: true
```

## west.yml
```yaml
manifest:
  remotes:
    - name: zmk-hotswap-connector-origin
      url-base: https://github.com/T0mmy312/zmk-hotswap-connector.git
  projects:
    # Together with the above defined remote, this refers to a module located at
    # https://github.com/remote-name/repository-name
    - name: zmk-hotswap-connector
      remote: zmk-hotswap-connector-origin
      # This points to a west manifest file in the remote module for further imports
      import: west.yml
```
